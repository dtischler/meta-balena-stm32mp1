## conf/layer.conf
```bitbake
BBPATH .= ":${LAYERDIR}"

BBFILES += "${LAYERDIR}/recipes-*/*/*.bb \
            ${LAYERDIR}/recipes-*/*/*.bbappend"

BBFILE_COLLECTIONS += "balena-stm32"
BBFILE_PATTERN_balena-stm32 := "^${LAYERDIR}/"
BBFILE_PRIORITY_balena-stm32 = "1337"

LAYERSERIES_COMPAT_balena-stm32 = "warrior"
```

## conf/machine/stm32mp1-av96.conf
```bitbake
#@TYPE: Machine
#@NAME: stm32mp1-av96
#@DESCRIPTION: Configuration for Avenger96 board
#@NEEDED_BSPLAYERS: layers/meta-openembedded/meta-oe layers/meta-openembedded/meta-python

PREFERRED_PROVIDER_virtual/bootloader = "u-boot"
PREFERRED_PROVIDER_virtual/kernel = "linux-mainline"

UBOOT_MACHINE = "stm32mp15_basic_defconfig"

MACHINEOVERRIDES .= ":stm32mpcommonmx"
MACHINEOVERRIDES .= ":stm32mp1-av96-common"

# =========================================================================
# Chip architecture
# =========================================================================
DEFAULTTUNE = "cortexa7thf-neon-vfpv4"
include conf/machine/include/tune-cortexa7.inc

KERNEL_DEVICETREE += "stm32mp157a-dhcor-avenger96.dtb"
KBUILD_DEFCONFIG_stm32mp1-av96 = "multi_v7_defconfig"
KERNEL_IMAGETYPE = "uImage"
UBOOT_ENTRYPOINT = "0xC2000040"

# =========================================================================
# Machine features
# =========================================================================
MACHINE_FEATURES += "bluetooth"
MACHINE_FEATURES += "wifi"
MACHINE_FEATURES += "splashscreen"
IMAGE_INSTALL_append = " linux-firmware"

SERIAL_CONSOLES = "115200;ttySTM0"
SERIAL_CONSOLE = "115200 ttySTM0"

# =========================================================================
# extlinux configuration
# =========================================================================
# As example, modify the default boot config for each target to M4 config
#UBOOT_EXTLINUX_DEFAULT_LABEL_mp157c-ev1_sdcard       = "stm32mp157c-ev1-m4-examples-sdcard"
#UBOOT_EXTLINUX_DEFAULT_LABEL_mp157c-ev1_sdcard-optee = "stm32mp157c-ev1-m4-examples-sdcard-optee"
```
